#include "dsi-panel-nt51021-boe-10wu-video.dtsi"
#include "dsi-panel-nt51021-boe-video.dtsi"
#include "clover-overlay.dtsi"

&mtp_batterydata {
	qcom,batt-id-range-pct = <15>;
	/* Remove unused battery nodes */
	/delete-node/ qcom,itech_3000mah;
	/delete-node/ qcom,ascent_3450mah;
	#include "batterydata-zql5018-6000mah.dtsi"
	#include "batterydata-zql6019-8600mah.dtsi"
};
